数据手册
========

* `ESP32-PICO-D4`_ (Datasheet)
* `ST7735`_ (Datasheet)
* `PCF8563`_ (Datasheet)
* `LSM9DS1`_ (Datasheet)
* `MPU9250`_ (Datasheet)
* `DRV2605`_ (Datasheet)
* `MAX30102`_ (Datasheet)
* `MAX30208`_ (Datasheet)

.. _ESP32-PICO-D4: https://www.espressif.com.cn/sites/default/files/documentation/esp32-pico-d4_datasheet_cn.pdf
.. _ST7735: http://www.displayfuture.com/Display/datasheet/controller/ST7735.pdf
.. _PCF8563: https://www.nxp.com.cn/docs/zh/data-sheet/PCF8563.pdf
.. _LSM9DS1: https://www.st.com/resource/en/datasheet/lsm9ds1.pdf
.. _MPU9250: https://invensense.tdk.com/wp-content/uploads/2015/02/PS-MPU-9250A-01-v1.1.pdf
.. _DRV2605: https://www.ti.com/lit/ds/symlink/drv2605.pdf?ts=1662177472179&ref_url=https%253A%252F%252Fwww.ti.com%252Fproduct%252FDRV2605
.. _MAX30102: https://datasheets.maximintegrated.com/en/ds/MAX30102.pdf
.. _MAX30208: https://datasheets.maximintegrated.com/en/ds/MAX30208.pdf
